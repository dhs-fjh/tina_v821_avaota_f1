## device/config/chips/v821/configs/perf2b/linux-5.4-ansc/bsp_recovery_defconfig
```kconfig
# CONFIG_LOCALVERSION_AUTO is not set
CONFIG_SYSVIPC=y
CONFIG_POSIX_MQUEUE=y
CONFIG_NO_HZ_IDLE=y
CONFIG_HIGH_RES_TIMERS=y
CONFIG_PREEMPT=y
CONFIG_IKCONFIG=y
CONFIG_IKCONFIG_PROC=y
CONFIG_CGROUPS=y
CONFIG_CGROUP_SCHED=y
CONFIG_CFS_BANDWIDTH=y
CONFIG_CGROUP_BPF=y
CONFIG_NAMESPACES=y
CONFIG_USER_NS=y
CONFIG_CHECKPOINT_RESTORE=y
CONFIG_BLK_DEV_INITRD=y
# CONFIG_RD_BZIP2 is not set
# CONFIG_RD_LZMA is not set
# CONFIG_RD_XZ is not set
# CONFIG_RD_LZO is not set
# CONFIG_RD_LZ4 is not set
CONFIG_CC_OPTIMIZE_FOR_SIZE=y
CONFIG_EXPERT=y
CONFIG_BPF_SYSCALL=y
CONFIG_ARCH_RV32I=y
# CONFIG_PMA is not set
CONFIG_CMDLINE="earlyprintk=sunxi-uart,0x42500000 loglevel=8 initcall_debug=1 console=ttyAS0 init=/init"
# CONFIG_SUSPEND is not set
CONFIG_CPU_FREQ=y
CONFIG_CPU_FREQ_STAT=y
CONFIG_CPU_FREQ_GOV_POWERSAVE=y
CONFIG_CPU_FREQ_GOV_USERSPACE=y
CONFIG_CPU_FREQ_GOV_ONDEMAND=y
CONFIG_CPU_FREQ_GOV_CONSERVATIVE=y
CONFIG_MODULES=y
CONFIG_AW_BSP=y
CONFIG_AW_KERNEL_ORIGIN=y
CONFIG_AW_IC_BOARD=y
CONFIG_AW_SOC_NAME="v821"
# CONFIG_AW_DDR_CCU is not set
# CONFIG_AW_UART is not set
CONFIG_AW_UART_NG=y
CONFIG_AW_SERIAL_CONSOLE=y
CONFIG_AW_SERLAL_NR_UARTS=4
CONFIG_AW_DMA=y
CONFIG_AW_NDMA=y
CONFIG_AW_RTC=y
CONFIG_AW_RTC_POWEROFF_ALARM=y
CONFIG_AW_RTC_FREE_RUNNING_COUNTER=y
# CONFIG_AW_DUMP_REG is not set
CONFIG_AW_WATCHDOG=y
CONFIG_AW_MBUS_GENERIC=y
CONFIG_AW_MMC_HSQ=y
CONFIG_AW_MMC=y
# CONFIG_AW_MMC_V4P1X is not set
# CONFIG_AW_MMC_V4P00X is not set
CONFIG_AW_MTD=y
CONFIG_AW_MTD_SUNXI_PARTS=y
CONFIG_AW_MTD_SPI_NOR_5_4=y
# CONFIG_MTD_SPI_NOR_USE_4K_SECTORS is not set
CONFIG_SPIF_SUNXI=y
# CONFIG_AW_VIDEO_ENCODER_DECODER is not set
CONFIG_AW_SYS_INFO=y
CONFIG_AW_SID=y
CONFIG_AW_GMAC=y
CONFIG_AW_TWI=y
CONFIG_AW_SPI_NG=y
CONFIG_AW_SPI_NG_ATOMIC_XFER=y
CONFIG_AW_SPI_SLAVETEST=m
CONFIG_AW_SPI_CAMERATEST=m
CONFIG_AW_PWM=y
# CONFIG_AW_PWM_DYNAMIC_DEBUG is not set
# CONFIG_AW_INPUT_SENSORINIT is not set
CONFIG_V821_FMAC_WLAN=m
CONFIG_V821_FMAC_RPMSG=m
CONFIG_AW_CPUFREQ_DT=y
CONFIG_ARM_AW_SUN50I_CPUFREQ_NVMEM=y
CONFIG_AW_MSGBOX=y
CONFIG_AW_HWSPINLOCK=y
CONFIG_AW_REMOTEPROC=y
# CONFIG_AW_RPMSG_RX_IN_KTHREAD is not set
CONFIG_AW_RPROC_SUBDEV=y
CONFIG_AW_RPROC_SUBDEV_WDT=y
CONFIG_SUNXI_RPROC_SHARE_IRQ=y
CONFIG_AW_REMOTEPROC_E907_BOOT=y
CONFIG_AW_REMOTEPROC_E907_STOP_NOTIFY=y
CONFIG_AW_RPMSG_CTRL=y
CONFIG_AW_RPBUF_SERVICE_RPMSG=y
CONFIG_AW_RPBUF_CONTROLLER_SUNXI=y
CONFIG_AW_MACADDR_MGT=y
CONFIG_AW_ANSC_DMA_ADAPT=y
CONFIG_CMA=y
CONFIG_NET=y
CONFIG_PACKET=y
CONFIG_UNIX=y
CONFIG_UNIX_DIAG=y
CONFIG_NET_KEY=y
CONFIG_INET=y
# CONFIG_INET_DIAG is not set
# CONFIG_IPV6 is not set
CONFIG_NETLINK_DIAG=y
CONFIG_FAILOVER=y
CONFIG_DEVTMPFS=y
CONFIG_DEVTMPFS_MOUNT=y
CONFIG_MTD=y
CONFIG_MTD_BLOCK=y
CONFIG_BLK_DEV_LOOP=y
# CONFIG_NET_VENDOR_ALACRITECH is not set
# CONFIG_NET_VENDOR_AMAZON is not set
# CONFIG_NET_VENDOR_AQUANTIA is not set
# CONFIG_NET_VENDOR_ARC is not set
# CONFIG_NET_VENDOR_AURORA is not set
# CONFIG_NET_VENDOR_BROADCOM is not set
# CONFIG_NET_VENDOR_CADENCE is not set
# CONFIG_NET_VENDOR_CAVIUM is not set
# CONFIG_NET_VENDOR_CORTINA is not set
# CONFIG_NET_VENDOR_EZCHIP is not set
# CONFIG_NET_VENDOR_FARADAY is not set
# CONFIG_NET_VENDOR_GOOGLE is not set
# CONFIG_NET_VENDOR_HUAWEI is not set
# CONFIG_NET_VENDOR_INTEL is not set
# CONFIG_NET_VENDOR_MARVELL is not set
# CONFIG_NET_VENDOR_MELLANOX is not set
# CONFIG_NET_VENDOR_MICREL is not set
# CONFIG_NET_VENDOR_MICROCHIP is not set
# CONFIG_NET_VENDOR_MICROSEMI is not set
# CONFIG_NET_VENDOR_NATSEMI is not set
# CONFIG_NET_VENDOR_NETRONOME is not set
# CONFIG_NET_VENDOR_NI is not set
# CONFIG_NET_VENDOR_PENSANDO is not set
# CONFIG_NET_VENDOR_QUALCOMM is not set
# CONFIG_NET_VENDOR_RENESAS is not set
# CONFIG_NET_VENDOR_ROCKER is not set
# CONFIG_NET_VENDOR_SAMSUNG is not set
# CONFIG_NET_VENDOR_SEEQ is not set
# CONFIG_NET_VENDOR_SOLARFLARE is not set
# CONFIG_NET_VENDOR_SOCIONEXT is not set
# CONFIG_NET_VENDOR_STMICRO is not set
# CONFIG_NET_VENDOR_SYNOPSYS is not set
# CONFIG_NET_VENDOR_VIA is not set
# CONFIG_NET_VENDOR_WIZNET is not set
# CONFIG_WLAN_VENDOR_ADMTEK is not set
# CONFIG_WLAN_VENDOR_ATH is not set
# CONFIG_WLAN_VENDOR_ATMEL is not set
# CONFIG_WLAN_VENDOR_BROADCOM is not set
# CONFIG_WLAN_VENDOR_CISCO is not set
# CONFIG_WLAN_VENDOR_INTEL is not set
# CONFIG_WLAN_VENDOR_INTERSIL is not set
# CONFIG_WLAN_VENDOR_MARVELL is not set
# CONFIG_WLAN_VENDOR_MEDIATEK is not set
# CONFIG_WLAN_VENDOR_RALINK is not set
# CONFIG_WLAN_VENDOR_REALTEK is not set
# CONFIG_WLAN_VENDOR_RSI is not set
# CONFIG_WLAN_VENDOR_ST is not set
# CONFIG_WLAN_VENDOR_TI is not set
# CONFIG_WLAN_VENDOR_ZYDAS is not set
# CONFIG_WLAN_VENDOR_QUANTENNA is not set
CONFIG_INPUT_EVDEV=y
# CONFIG_INPUT_KEYBOARD is not set
# CONFIG_INPUT_MOUSE is not set
CONFIG_VT_HW_CONSOLE_BINDING=y
# CONFIG_LEGACY_PTYS is not set
CONFIG_SERIAL_EARLYCON_RISCV_SBI=y
CONFIG_HVC_RISCV_SBI=y
CONFIG_VIRTIO_CONSOLE=y
CONFIG_HW_RANDOM=y
CONFIG_HW_RANDOM_VIRTIO=y
CONFIG_I2C_MUX=y
CONFIG_SPI_SPIDEV=y
CONFIG_POWER_SUPPLY=y
CONFIG_REGULATOR=y
CONFIG_REGULATOR_FIXED_VOLTAGE=y
# CONFIG_VGA_CONSOLE is not set
# CONFIG_HID is not set
# CONFIG_USB_SUPPORT is not set
CONFIG_MMC=y
CONFIG_MMC_QUEUE_DEPTH=16
CONFIG_VIRTIO_MMIO=y
CONFIG_STAGING=y
CONFIG_IIO=y
CONFIG_SIFIVE_PLIC=y
CONFIG_RAS=y
CONFIG_EXT4_FS=y
CONFIG_EXT4_FS_POSIX_ACL=y
CONFIG_AUTOFS4_FS=y
CONFIG_FUSE_FS=y
CONFIG_OVERLAY_FS=y
CONFIG_MSDOS_FS=y
CONFIG_VFAT_FS=y
CONFIG_TMPFS=y
CONFIG_TMPFS_POSIX_ACL=y
CONFIG_CONFIGFS_FS=y
CONFIG_JFFS2_FS=y
CONFIG_NLS_CODEPAGE_437=y
CONFIG_NLS_ISO8859_1=y
CONFIG_CRYPTO_DEFLATE=y
CONFIG_CRYPTO_USER_API_HASH=y
# CONFIG_CRYPTO_DEV_VIRTIO is not set
CONFIG_DMA_CMA=y
CONFIG_PRINTK_TIME=y
CONFIG_DYNAMIC_DEBUG=y
# CONFIG_DEBUG_BUGVERBOSE is not set
```

## device/config/chips/v821/configs/perf2b_fastboot/linux-5.4-ansc/bsp_defconfig
```kconfig
# CONFIG_LOCALVERSION_AUTO is not set
# CONFIG_SWAP is not set
CONFIG_SYSVIPC=y
CONFIG_POSIX_MQUEUE=y
CONFIG_NO_HZ_IDLE=y
CONFIG_HIGH_RES_TIMERS=y
CONFIG_PREEMPT=y
CONFIG_IKCONFIG=y
CONFIG_IKCONFIG_PROC=y
CONFIG_CHECKPOINT_RESTORE=y
CONFIG_AW_ROOTFS_READAHEAD=y
CONFIG_CC_OPTIMIZE_FOR_SIZE=y
CONFIG_EXPERT=y
CONFIG_SYSCTL_SYSCALL=y
# CONFIG_KALLSYMS is not set
# CONFIG_SLUB_SYS_INFO is not set
CONFIG_FASTBOOT_PRINT_BOOTTIME=y
CONFIG_DISCARD_BUILTIN_PARAM=y
CONFIG_ARCH_RV32I=y
# CONFIG_PMA is not set
CONFIG_CMDLINE="earlyprintk=sunxi-uart,0x42500000 loglevel=8 initcall_debug=1 console=ttyAS0 init=/init"
CONFIG_JIFFIES_CLOCKSOURCE=y
CONFIG_JIFFIES_CLOCKSOURCE_MEM_BASE=0x48400000
CONFIG_CPU_FREQ=y
CONFIG_CPU_FREQ_STAT=y
CONFIG_CPU_FREQ_GOV_POWERSAVE=y
CONFIG_CPU_FREQ_GOV_USERSPACE=y
CONFIG_CPU_FREQ_GOV_ONDEMAND=y
CONFIG_CPU_FREQ_GOV_CONSERVATIVE=y
CONFIG_MODULES=y
# CONFIG_BLK_DEV_BSG is not set
# CONFIG_BLK_DEBUG_FS is not set
CONFIG_AW_BSP=y
CONFIG_AW_KERNEL_ORIGIN=y
CONFIG_AW_IC_BOARD=y
CONFIG_AW_SOC_NAME="v821"
CONFIG_AW_IPC_FASTBOOT=y
# CONFIG_AW_DDR_CCU is not set
# CONFIG_AW_UART is not set
CONFIG_AW_UART_NG=y
CONFIG_AW_SERIAL_CONSOLE=y
# CONFIG_AW_EARLY_PRINTK is not set
CONFIG_AW_SERLAL_NR_UARTS=4
CONFIG_AW_DMA=y
CONFIG_AW_RTC=y
CONFIG_AW_RTC_REBOOT_FLAG=y
CONFIG_AW_RTC_POWEROFF_ALARM=y
CONFIG_AW_RTC_FREE_RUNNING_COUNTER=y
CONFIG_AW_WATCHDOG=y
CONFIG_AW_MBUS_GENERIC=y
CONFIG_AW_MMC_HSQ=y
CONFIG_AW_MMC=y
CONFIG_AW_MTD=y
CONFIG_AW_MTD_SUNXI_PARTS=y
CONFIG_AW_MTD_SPI_NOR_5_4=y
CONFIG_SPINOR_UBOOT_OFFSET=280
# CONFIG_MTD_SPI_NOR_USE_4K_SECTORS is not set
CONFIG_SPIF_SUNXI=y
CONFIG_AW_SPIF_DELAYINIT=y
CONFIG_AW_VIDEO_SUNXI_VIN=y
CONFIG_CSI_VIN=y
CONFIG_ENABLE_SENSOR_FLIP_OPTION=y
CONFIG_VIDEO_SUNXI_VIN_SPECIAL=y
# CONFIG_FLASH is not set
# CONFIG_SENSOR_LIST is not set
CONFIG_VIN_USE_ION_SIZE_POOL_HEAP=y
CONFIG_D3D=y
# CONFIG_SAME_I2C is not set
CONFIG_ISP_SERVER_MELIS=y
CONFIG_VIN_INIT_MELIS=y
CONFIG_ISP0_THRESHOLD_PARAM_OFFSET=263
CONFIG_ISP1_THRESHOLD_PARAM_OFFSET=271
CONFIG_ISP_REG_DEBUG_NODE=y
CONFIG_SENSOR_GC1084_MIPI=y
CONFIG_AW_VIDEO_KERNEL_ENC=y
CONFIG_VIDEO_RT_MEDIA=y
CONFIG_SND_SOC_SUNXI_AAUDIO=y
CONFIG_SND_SOC_SUNXI_I2S=y
CONFIG_AW_SYS_INFO=y
CONFIG_AW_SID=y
CONFIG_AW_WUPIO=y
CONFIG_AW_WUPIO_KEYBOARD_GPIO=y
CONFIG_AW_PCIE_NONE=y
CONFIG_USB_EHCI_HCD_SUNXI=y
CONFIG_USB_OHCI_HCD_SUNXI=y
CONFIG_USB_SUNXI_HCD=y
CONFIG_USB_SUNXI_HCI=y
CONFIG_USB_SUNXI_EHCI0=y
CONFIG_USB_SUNXI_OHCI0=y
CONFIG_USB_SUNXI_USB=y
CONFIG_USB_SUNXI_USB_MANAGER=y
CONFIG_USB_SUNXI_USB_ADB=y
CONFIG_USB_SUNXI_UDC0=y
CONFIG_AW_TWI=y
CONFIG_AW_TWI_DELAYINIT=y
CONFIG_AW_TWI_DYNAMIC_DEBUG=y
CONFIG_AW_SPI_NG=y
# CONFIG_AW_SPI_NG_DBI is not set
# CONFIG_AW_SPI_NG_CAMERA is not set
CONFIG_AW_SPI_NG_ATOMIC_XFER=y
CONFIG_AW_PWM=y
CONFIG_AW_GPADC=y
CONFIG_AW_INPUT_SENSORINIT=y
CONFIG_AW_INPUT_SENSOR=y
# CONFIG_SENSOR_MSA is not set
CONFIG_V821_FMAC_WLAN=m
CONFIG_V821_FMAC_RPMSG=m
CONFIG_AW_THERMAL=y
CONFIG_AW_REGULATOR_SOC_PMU=y
CONFIG_AW_CPUFREQ_DT=y
CONFIG_ARM_AW_SUN50I_CPUFREQ_NVMEM=y
CONFIG_AW_RISCV_SUSPEND=y
CONFIG_AW_MSGBOX=y
CONFIG_AW_HWSPINLOCK=y
CONFIG_AW_REMOTEPROC=y
CONFIG_AW_RPROC_FAST_BOOT=y
CONFIG_AW_RPROC_SUBDEV=y
CONFIG_AW_RPROC_SUBDEV_WDT=y
CONFIG_SUNXI_RPROC_SHARE_IRQ=y
CONFIG_AW_REMOTEPROC_E907_BOOT=y
CONFIG_AW_REMOTEPROC_E907_STOP_NOTIFY=y
CONFIG_AW_RPMSG_CTRL=y
CONFIG_AW_RPMSG_NOTIFY=y
CONFIG_AW_RPBUF_SERVICE_RPMSG=y
CONFIG_AW_RPBUF_CONTROLLER_SUNXI=y
CONFIG_AW_RFKILL=y
CONFIG_AW_MACADDR_MGT=y
CONFIG_AW_FLASHAPP=y
CONFIG_AW_ISP_PARAM=y
CONFIG_AW_ANSC_DMA_ADAPT=y
CONFIG_ION_SIZE_POOL_HEAP=y
CONFIG_CMA=y
CONFIG_NET=y
CONFIG_PACKET=y
CONFIG_UNIX=y
CONFIG_UNIX_DIAG=y
CONFIG_NET_KEY=y
CONFIG_INET=y
# CONFIG_INET_DIAG is not set
# CONFIG_IPV6 is not set
CONFIG_DNS_RESOLVER=y
CONFIG_NETLINK_DIAG=y
CONFIG_FAILOVER=y
CONFIG_DEVTMPFS=y
CONFIG_DEVTMPFS_MOUNT=y
CONFIG_DEFERRED_DEV=y
CONFIG_DEFERRED_RUN=y
CONFIG_MTD=y
CONFIG_MTD_BLOCK=y
CONFIG_DISCARD_SYS_DEVICETREE=y
CONFIG_NETDEVICES=y
# CONFIG_ETHERNET is not set
# CONFIG_USB_NET_DRIVERS is not set
# CONFIG_WLAN_VENDOR_ADMTEK is not set
# CONFIG_WLAN_VENDOR_ATH is not set
# CONFIG_WLAN_VENDOR_ATMEL is not set
# CONFIG_WLAN_VENDOR_BROADCOM is not set
# CONFIG_WLAN_VENDOR_CISCO is not set
# CONFIG_WLAN_VENDOR_INTEL is not set
# CONFIG_WLAN_VENDOR_INTERSIL is not set
# CONFIG_WLAN_VENDOR_MARVELL is not set
# CONFIG_WLAN_VENDOR_MEDIATEK is not set
# CONFIG_WLAN_VENDOR_RALINK is not set
# CONFIG_WLAN_VENDOR_RSI is not set
# CONFIG_WLAN_VENDOR_ST is not set
# CONFIG_WLAN_VENDOR_TI is not set
# CONFIG_WLAN_VENDOR_ZYDAS is not set
# CONFIG_WLAN_VENDOR_QUANTENNA is not set
# CONFIG_INPUT_MOUSE is not set
# CONFIG_LEGACY_PTYS is not set
CONFIG_SERIAL_EARLYCON_RISCV_SBI=y
# CONFIG_HW_RANDOM is not set
CONFIG_SPI_SPIDEV=y
CONFIG_SPI_SLAVE=y
CONFIG_POWER_SUPPLY=y
CONFIG_THERMAL_STATISTICS=y
CONFIG_THERMAL_EMERGENCY_POWEROFF_DELAY_MS=10000
CONFIG_THERMAL_WRITABLE_TRIPS=y
CONFIG_THERMAL_DEFAULT_GOV_POWER_ALLOCATOR=y
CONFIG_THERMAL_GOV_FAIR_SHARE=y
CONFIG_THERMAL_GOV_STEP_WISE=y
CONFIG_THERMAL_GOV_BANG_BANG=y
CONFIG_THERMAL_GOV_USER_SPACE=y
CONFIG_THERMAL_EMULATION=y
CONFIG_MEDIA_CAMERA_SUPPORT=y
CONFIG_MEDIA_CONTROLLER=y
CONFIG_VIDEO_V4L2_SUBDEV_API=y
CONFIG_V4L_PLATFORM_DRIVERS=y
CONFIG_FB=y
CONFIG_BACKLIGHT_CLASS_DEVICE=y
CONFIG_SOUND=y
CONFIG_SND=y
CONFIG_SND_SOC=y
CONFIG_USB=y
CONFIG_USB_ANNOUNCE_NEW_DEVICES=y
CONFIG_USB_XHCI_HCD=y
CONFIG_USB_XHCI_PLATFORM=y
CONFIG_USB_EHCI_HCD=y
CONFIG_USB_EHCI_HCD_PLATFORM=y
CONFIG_USB_OHCI_HCD=y
CONFIG_USB_OHCI_HCD_PLATFORM=y
CONFIG_USB_GADGET=y
CONFIG_USB_CONFIGFS=y
CONFIG_USB_CONFIGFS_MASS_STORAGE=y
CONFIG_USB_CONFIGFS_F_FS=y
CONFIG_USB_ROLE_SWITCH=y
CONFIG_MMC=y
CONFIG_MMC_QUEUE_DEPTH=16
CONFIG_SYNC_FILE=y
# CONFIG_VIRTIO_MENU is not set
CONFIG_STAGING=y
CONFIG_ION=y
CONFIG_ION_CMA_HEAP=y
CONFIG_EXFAT_FS=y
# CONFIG_EXFAT_DONT_MOUNT_VFAT is not set
# CONFIG_COMMON_CLK_DEBUG is not set
# CONFIG_IOMMU_SUPPORT is not set
CONFIG_SIFIVE_PLIC=y
CONFIG_RAS=y
CONFIG_ANDROID=y
CONFIG_AUTOFS4_FS=y
CONFIG_FUSE_FS=y
CONFIG_OVERLAY_FS=y
CONFIG_VFAT_FS=y
CONFIG_TMPFS=y
CONFIG_TMPFS_POSIX_ACL=y
CONFIG_JFFS2_FS=y
CONFIG_SQUASHFS=y
# CONFIG_SQUASHFS_ZLIB is not set
CONFIG_SQUASHFS_LZO=y
# CONFIG_NETWORK_FILESYSTEMS is not set
CONFIG_NLS_CODEPAGE_437=y
CONFIG_NLS_ISO8859_1=y
CONFIG_KEYS=y
CONFIG_CRYPTO_MANAGER=y
CONFIG_CRYPTO_CRC32C=y
CONFIG_CRYPTO_USER_API_HASH=y
CONFIG_CRYPTO_DEV_VIRTIO=y
CONFIG_CRC16=y
CONFIG_XZ_DEC=y
# CONFIG_XZ_DEC_X86 is not set
# CONFIG_XZ_DEC_POWERPC is not set
# CONFIG_XZ_DEC_IA64 is not set
# CONFIG_XZ_DEC_ARM is not set
# CONFIG_XZ_DEC_ARMTHUMB is not set
# CONFIG_XZ_DEC_SPARC is not set
CONFIG_DMA_CMA=y
CONFIG_PRINTK_TIME=y
CONFIG_DEBUG_FS=y
# CONFIG_DEBUG_PREEMPT is not set
# CONFIG_FTRACE is not set
# CONFIG_RUNTIME_TESTING_MENU is not set
```
