## device/config/chips/v821/configs/sc1745v/linux-5.4-ansc/bsp_defconfig
```kconfig
# CONFIG_LOCALVERSION_AUTO is not set
# CONFIG_SWAP is not set
CONFIG_SYSVIPC=y
CONFIG_NO_HZ_IDLE=y
CONFIG_HIGH_RES_TIMERS=y
CONFIG_PREEMPT=y
CONFIG_IKCONFIG=y
CONFIG_IKCONFIG_PROC=y
CONFIG_LOG_BUF_SHIFT=15
CONFIG_CHECKPOINT_RESTORE=y
CONFIG_AW_ROOTFS_READAHEAD=y
CONFIG_CC_OPTIMIZE_FOR_SIZE=y
CONFIG_EXPERT=y
CONFIG_SYSCTL_SYSCALL=y
# CONFIG_KALLSYMS is not set
# CONFIG_VM_EVENT_COUNTERS is not set
# CONFIG_SLUB_SYS_INFO is not set
CONFIG_FASTBOOT_PRINT_BOOTTIME=y
CONFIG_DISCARD_BUILTIN_PARAM=y
CONFIG_ARCH_RV32I=y
# CONFIG_PMA is not set
CONFIG_CMDLINE="earlyprintk=sunxi-uart,0x42500000 loglevel=8 initcall_debug=1 console=ttyAS0 init=/init"
CONFIG_JIFFIES_CLOCKSOURCE=y
CONFIG_JIFFIES_CLOCKSOURCE_MEM_BASE=0x48400000
CONFIG_JIFFIES_CLOCKSOURCE_FREQ=24000000
# CONFIG_SUSPEND is not set
CONFIG_CPU_FREQ=y
CONFIG_MODULES=y
# CONFIG_BLK_DEV_BSG is not set
# CONFIG_BLK_DEBUG_FS is not set
CONFIG_AW_BSP=y
CONFIG_AW_KERNEL_ORIGIN=y
CONFIG_AW_IC_BOARD=y
CONFIG_AW_SOC_NAME="v821"
CONFIG_AW_BSP_LOWMEM=y
CONFIG_AW_IPC_FASTBOOT=y
# CONFIG_AW_DDR_CCU is not set
# CONFIG_AW_UART is not set
CONFIG_AW_UART_NG=y
CONFIG_AW_SERIAL_CONSOLE=y
# CONFIG_AW_EARLY_PRINTK is not set
CONFIG_AW_SERLAL_NR_UARTS=4
CONFIG_AW_DMA=y
CONFIG_AW_RTC=y
CONFIG_AW_RTC_REBOOT_FLAG=y
CONFIG_AW_RTC_POWEROFF_ALARM=y
CONFIG_AW_RTC_FREE_RUNNING_COUNTER=y
CONFIG_AW_WATCHDOG=y
CONFIG_AW_MBUS_GENERIC=y
CONFIG_AW_MTD=y
CONFIG_AW_MTD_SUNXI_PARTS=y
CONFIG_AW_MTD_SPI_NOR_5_4=y
CONFIG_SPINOR_UBOOT_OFFSET=280
# CONFIG_MTD_SPI_NOR_USE_4K_SECTORS is not set
CONFIG_SPIF_SUNXI=y
CONFIG_AW_SPIF_DELAYINIT=y
CONFIG_AW_G2D=y
CONFIG_G2D_RCQ=y
# CONFIG_G2D_MIXER is not set
CONFIG_AW_VIDEO_SUNXI_VIN=y
CONFIG_CSI_VIN=y
CONFIG_ENABLE_SENSOR_FLIP_OPTION=y
CONFIG_VIDEO_SUNXI_VIN_SPECIAL=y
# CONFIG_FLASH is not set
# CONFIG_SENSOR_LIST is not set
CONFIG_SUPPORT_ISP_TDM=y
CONFIG_VIN_USE_ION_SIZE_POOL_HEAP=y
CONFIG_D3D=y
# CONFIG_SAME_I2C is not set
CONFIG_ISP_SERVER_MELIS=y
CONFIG_VIN_INIT_MELIS=y
CONFIG_ISP0_THRESHOLD_PARAM_OFFSET=263
CONFIG_ISP1_THRESHOLD_PARAM_OFFSET=271
CONFIG_ISP_REG_DEBUG_NODE=y
CONFIG_SENSOR_OV02B10_MIPI=y
CONFIG_AW_VIDEO_KERNEL_ENC=y
CONFIG_VIDEO_RT_MEDIA=y
CONFIG_RT_MEDIA_DUAL_SENSOR=y
CONFIG_RT_MEDIA_CDC_LOG_LEVEL=5
# CONFIG_RT_MEDIA_SETUP_RECORDER_IN_KERNEL is not set
CONFIG_SND_SOC_SUNXI_AAUDIO=y
CONFIG_SND_SOC_SUNXI_I2S=y
CONFIG_AW_SYS_INFO=y
CONFIG_AW_SID=y
CONFIG_AW_PCIE_NONE=y
CONFIG_USB_EHCI_HCD_SUNXI=y
CONFIG_USB_OHCI_HCD_SUNXI=y
CONFIG_USB_SUNXI_HCD=y
CONFIG_USB_SUNXI_HCI=y
CONFIG_USB_SUNXI_EHCI0=y
CONFIG_USB_SUNXI_OHCI0=y
CONFIG_USB_SUNXI_USB=y
CONFIG_USB_SUNXI_USB_MANAGER=y
CONFIG_USB_SUNXI_USB_ADB=y
CONFIG_USB_SUNXI_UDC0=y
CONFIG_USB_SUNXI_GADGET=y
CONFIG_USB_SUNXI_CONFIGFS_F_UVC=y
CONFIG_USB_SUNXI_CONFIGFS_F_UAC1=y
CONFIG_AW_TWI=y
CONFIG_AW_TWI_DELAYINIT=y
CONFIG_AW_TWI_DYNAMIC_DEBUG=y
CONFIG_AW_SPI_NG=y
# CONFIG_AW_SPI_NG_DBI is not set
# CONFIG_AW_SPI_NG_CAMERA is not set
CONFIG_AW_SPI_NG_ATOMIC_XFER=y
CONFIG_AW_PWM=y
CONFIG_AW_THERMAL=y
CONFIG_AW_REGULATOR_SOC_PMU=y
CONFIG_AW_CPUFREQ_DT=y
CONFIG_ARM_AW_SUN50I_CPUFREQ_NVMEM=y
CONFIG_AW_RISCV_SUSPEND=y
CONFIG_AW_MSGBOX=y
CONFIG_AW_HWSPINLOCK=y
CONFIG_AW_REMOTEPROC=y
CONFIG_AW_RPROC_FAST_BOOT=y
CONFIG_AW_RPROC_SUBDEV=y
CONFIG_AW_RPROC_SUBDEV_WDT=y
CONFIG_SUNXI_RPROC_SHARE_IRQ=y
CONFIG_AW_REMOTEPROC_E907_BOOT=y
CONFIG_AW_REMOTEPROC_E907_STOP_NOTIFY=y
CONFIG_AW_RPMSG_CTRL=y
CONFIG_AW_RPMSG_NOTIFY=y
CONFIG_AW_RPBUF_SERVICE_RPMSG=y
CONFIG_AW_RPBUF_CONTROLLER_SUNXI=y
CONFIG_AW_FLASHAPP=y
CONFIG_AW_ISP_PARAM=y
CONFIG_AW_ANSC_DMA_ADAPT=y
CONFIG_ION_SIZE_POOL_HEAP=y
CONFIG_CMA=y
CONFIG_NET=y
# CONFIG_WIRELESS is not set
CONFIG_DEVTMPFS=y
CONFIG_DEVTMPFS_MOUNT=y
CONFIG_DEFERRED_DEV=y
CONFIG_DEFERRED_RUN=y
CONFIG_MTD=y
CONFIG_MTD_BLOCK=y
CONFIG_DISCARD_SYS_DEVICETREE=y
# CONFIG_INPUT is not set
# CONFIG_SERIO is not set
# CONFIG_VT is not set
# CONFIG_LEGACY_PTYS is not set
# CONFIG_DEVMEM is not set
CONFIG_SERIAL_EARLYCON_RISCV_SBI=y
# CONFIG_HW_RANDOM is not set
# CONFIG_I2C_HELPER_AUTO is not set
CONFIG_SPI_SPIDEV=y
CONFIG_SPI_SLAVE=y
CONFIG_POWER_SUPPLY=y
CONFIG_THERMAL_STATISTICS=y
CONFIG_THERMAL_EMERGENCY_POWEROFF_DELAY_MS=10000
CONFIG_THERMAL_WRITABLE_TRIPS=y
CONFIG_THERMAL_DEFAULT_GOV_POWER_ALLOCATOR=y
CONFIG_THERMAL_GOV_FAIR_SHARE=y
CONFIG_THERMAL_GOV_STEP_WISE=y
CONFIG_THERMAL_GOV_BANG_BANG=y
CONFIG_THERMAL_GOV_USER_SPACE=y
CONFIG_THERMAL_EMULATION=y
CONFIG_MEDIA_CAMERA_SUPPORT=y
CONFIG_MEDIA_CONTROLLER=y
CONFIG_VIDEO_V4L2_SUBDEV_API=y
CONFIG_V4L_PLATFORM_DRIVERS=y
CONFIG_BACKLIGHT_CLASS_DEVICE=y
CONFIG_SOUND=y
CONFIG_SND=y
CONFIG_SND_SOC=y
CONFIG_USB=y
CONFIG_USB_ANNOUNCE_NEW_DEVICES=y
CONFIG_USB_EHCI_HCD=y
CONFIG_USB_EHCI_HCD_PLATFORM=y
CONFIG_USB_OHCI_HCD=y
CONFIG_USB_OHCI_HCD_PLATFORM=y
CONFIG_USB_GADGET=y
CONFIG_USB_CONFIGFS=y
CONFIG_SYNC_FILE=y
# CONFIG_VIRTIO_MENU is not set
CONFIG_STAGING=y
CONFIG_ION=y
CONFIG_ION_CMA_HEAP=y
# CONFIG_COMMON_CLK_DEBUG is not set
# CONFIG_IOMMU_SUPPORT is not set
CONFIG_SIFIVE_PLIC=y
CONFIG_ANDROID=y
# CONFIG_NVMEM_SYSFS is not set
CONFIG_AUTOFS4_FS=y
CONFIG_TMPFS=y
CONFIG_TMPFS_POSIX_ACL=y
CONFIG_JFFS2_FS=y
CONFIG_SQUASHFS=y
# CONFIG_SQUASHFS_ZLIB is not set
CONFIG_SQUASHFS_LZO=y
# CONFIG_NETWORK_FILESYSTEMS is not set
CONFIG_NLS_CODEPAGE_437=y
CONFIG_NLS_ISO8859_1=y
CONFIG_CRYPTO=y
CONFIG_CRYPTO_MANAGER=y
CONFIG_CRYPTO_CRC32C=y
# CONFIG_CRYPTO_HW is not set
CONFIG_DMA_CMA=y
CONFIG_PRINTK_TIME=y
CONFIG_DEBUG_FS=y
# CONFIG_DEBUG_MISC is not set
# CONFIG_SCHED_DEBUG is not set
# CONFIG_DEBUG_PREEMPT is not set
# CONFIG_DEBUG_BUGVERBOSE is not set
# CONFIG_FTRACE is not set
# CONFIG_RUNTIME_TESTING_MENU is not set
```
